&huawei_wifi_info {
	compatible = "huawei,huawei_wifi_info";
	status = "okay";
	ini_type = "JLH";
	wifi_chiptype = "WIFI_MTK_6635X";
	power_limit = "JLH";
	antenna_types = "JLH";
	wifi_cfg_type = "JLH_";
};
