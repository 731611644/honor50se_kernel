/dts-v1/;
/plugin/;
#include <dt-bindings/interrupt-controller/irq.h>
#include <dt-bindings/interrupt-controller/arm-gic.h>
#ifndef CONFIG_FPGA_EARLY_PORTING
#include <dt-bindings/pinctrl/mt6877-pinfunc.h>
#endif
#include "mediatek/hihonor_mt6877_jlh_an00_vh/hihonor.dtsi"

&rootparam {
	mtk,boardid = <4 0 6 8>;
	mtk,board_name = "JLH_AN00_VH";
	mtk,product_name = "JLH-AN00";
	hardware_version = "HN1JULAM";
};

&antenna_board_match {
	antenna_board_match_range = <0 450>;
};

#include <honor_mt6877_jlh/cust.dtsi>

/*End of this file, DO NOT ADD ANYTHING HERE*/
