&huawei_wifi_info {
	compatible = "huawei,huawei_wifi_info";
	status = "okay";
	ini_type = "NTX";
	wifi_chiptype = "WIFI_MTK_6635X";
	power_limit = "NTX";
	antenna_types = "NTX";
	wifi_cfg_type = "NTX_";
};
