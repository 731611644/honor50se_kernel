/dts-v1/;
/plugin/;
#include <dt-bindings/interrupt-controller/irq.h>
#include <dt-bindings/interrupt-controller/arm-gic.h>
#ifndef CONFIG_FPGA_EARLY_PORTING
#include <dt-bindings/pinctrl/mt6833-pinfunc.h>
#endif
#include "mediatek/hihonor_mt6833_tfy_an00_va/hihonor.dtsi"

&rootparam {
	mtk,boardid = <4 1 1 4>;
	mtk,board_name = "TFY_AN00_VA";
	mtk,product_name = "TFY-AN00";
	hardware_version = "HN1TFYM";
};

#include <k6833v1_64_tif/cust.dtsi>

/*End of this file, DO NOT ADD ANYTHING HERE*/
