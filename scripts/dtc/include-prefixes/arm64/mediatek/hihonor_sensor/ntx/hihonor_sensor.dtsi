&huawei_sensor_info {
	compatible = "huawei,huawei_sensor_info";
	huawei_virt_prox = <1>;
	product_number = <12>;
	lsm6dsm_direction = <0>;
	bmi160_direction = <3>;
	icm4n607_direction = <0>;
	gyro_calibrate_timeout = <5000>;

	status = "okay";
};
