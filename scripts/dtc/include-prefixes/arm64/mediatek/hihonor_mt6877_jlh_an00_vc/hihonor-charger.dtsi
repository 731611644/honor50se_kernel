#include "../hihonor_charger/mt6877_jlh_honor_charger.dtsi"
#include "../hihonor_charger/mt6877_jlh_honor_outside_fuel.dtsi"

&i2c7 {
	cw2217_fg@64 {
		status = "ok";
	};
};

&huawei_batt_info {
	shield_ct_sign = <1>;
};
