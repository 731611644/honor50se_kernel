&huawei_sensor_info {
	compatible = "huawei,huawei_sensor_info";
	bma4xy_direction = <0>;
	kx022_direction = <0>;
	lis2dwl_direction = <0>;
	huawei_virt_prox = <1>;
	gyro_calibrate_timeout = <5000>;
	product_number = <13>;
	cali_check_type = <0x11>; // when status = "disable", delete this
	status = "okay";
};