/*---------------------------------------------------------------------------
 * This file is autogenerated file using huawei LCD parser. Please do not edit it.
 * Update input XML file to add a new entry or update variable in this file
 * Parser location: vendor/huawei/chipset_common/devkit/lcdkit/tools 
 *---------------------------------------------------------------------------*/


#include "ntx_110_208_6p7.dtsi"
#include "ntx_190_208_6p7.dtsi"
#include "ntx_290_105_6p7.dtsi"
#include "ntx_290_208_6p7.dtsi"
#include "ntx_auo_otm1901a_5p2_1080p_video_default.dtsi"