/* Copyright (c) 2013, The Linux Foundation. All rights reserved.
 *
 * This program is free software; you can redistribute it and/or modify
 * it under the terms of the GNU General Public License version 2 and
 * only version 2 as published by the Free Software Foundation.
 *
 * This program is distributed in the hope that it will be useful,
 * but WITHOUT ANY WARRANTY; without even the implied warranty of
 * MERCHANTABILITY or FITNESS FOR A PARTICULAR PURPOSE.  See the
 * GNU General Public License for more details.
 */

/*-------------------------------------------------------------------------
 * This file is autogenerated file using gcdb parser. Please do not edit it.
 * Update input XML file to add a new entry or update variable in this file
 * VERSION = 1.1
 *-----------------------------------------------------------------------*/
&huawei_lcd_config {
	dsi_jlh_110_208_6p78: lcd_kit_jlh_110_208_6p78 {
		compatible = "110_208_6p78";
		lcd-kit,panel-name = "110_208 6.78' 1080 x 2388";
		lcd-kit,panel-type = <0x01>;
		lcd-kit,panel-xres = <1080>;
		lcd-kit,panel-yres = <2388>;
		lcd-kit,panel-width = <73>;
		lcd-kit,panel-height = <158>;
		lcd-kit,panel-on-cmds = <0x15 0x01 0x00 0x00 0x0a 0x00 0x02 0XFF 0X25
		0x15 0x01 0x00 0x00 0x0a 0x00 0x02 0XFB 0X01
		0x15 0x01 0x00 0x00 0x0a 0x00 0x02 0X18 0X20
		0x15 0x01 0x00 0x00 0x0a 0x00 0x02 0XFF 0X10
		0x15 0x01 0x00 0x00 0x0a 0x00 0x02 0XFB 0X01
		0x15 0x01 0x00 0x00 0x0a 0x00 0x02 0X36 0X00
		0x39 0x01 0x00 0x00 0x0a 0x00 0x06 0X3B 0X03 0X12 0X38 0X04 0X04
		0x15 0x01 0x00 0x00 0x0a 0x00 0x02 0XB0 0X00
		0x15 0x01 0x00 0x00 0x0a 0x00 0x02 0XC0 0X03
		0x39 0x01 0x00 0x00 0x0a 0x00 0x11 0XC1 0X89 0X28 0X00 0X0C 0X02 0X00 0X02 0X0E 0X01 0X1F 0X00 0X07 0X08 0XBB 0X08 0X7A
		0x39 0x01 0x00 0x00 0x0a 0x00 0x03 0XC2 0X10 0XF0
		0x15 0x01 0x00 0x00 0x0a 0x00 0x02 0XFF 0XF0
		0x15 0x01 0x00 0x00 0x0a 0x00 0x02 0XFB 0X01
		0x15 0x01 0x00 0x00 0x0a 0x00 0x02 0X1C 0X01
		0x15 0x01 0x00 0x00 0x0a 0x00 0x02 0X33 0X01
		0x15 0x01 0x00 0x00 0x0a 0x00 0x02 0X5A 0X00
		0x15 0x01 0x00 0x00 0x0a 0x00 0x02 0XBE 0X08
		0x15 0x01 0x00 0x00 0x0a 0x00 0x02 0XD2 0X50
		0x15 0x01 0x00 0x00 0x0a 0x00 0x02 0X84 0X08
		0x15 0x01 0x00 0x00 0x0a 0x00 0x02 0X85 0X0C
		0x15 0x01 0x00 0x00 0x0a 0x00 0x02 0XFF 0X25
		0x15 0x01 0x00 0x00 0x0a 0x00 0x02 0XFB 0X01
		0x15 0x01 0x00 0x00 0x0a 0x00 0x02 0XBD 0X01
		0x15 0x01 0x00 0x00 0x0a 0x00 0x02 0X91 0X1F
		0x15 0x01 0x00 0x00 0x0a 0x00 0x02 0X92 0X0F
		0x15 0x01 0x00 0x00 0x0a 0x00 0x02 0X94 0X18
		0x15 0x01 0x00 0x00 0x0a 0x00 0x02 0X95 0X03
		0x15 0x01 0x00 0x00 0x0a 0x00 0x02 0X96 0X01
		0x15 0x01 0x00 0x00 0x0a 0x00 0x02 0X93 0X01
		0x15 0x01 0x00 0x00 0x0a 0x00 0x02 0XFF 0XE0
		0x15 0x01 0x00 0x00 0x0a 0x00 0x02 0XFB 0X01
		0x15 0x01 0x00 0x00 0x0a 0x00 0x02 0X35 0X82
		0x15 0x01 0x00 0x00 0x0a 0x00 0x02 0XFF 0XC0
		0x15 0x01 0x00 0x00 0x0a 0x00 0x02 0XFB 0X01
		0x15 0x01 0x00 0x00 0x0a 0x00 0x02 0X9C 0X11
		0x15 0x01 0x00 0x00 0x0a 0x00 0x02 0X9D 0X11
		0x15 0x01 0x00 0x00 0x0a 0x00 0x02 0XFF 0X10
		0x15 0x01 0x00 0x00 0x0a 0x01 0x02 0X11 0x00
		0x15 0x01 0x00 0x00 0x00 0x00 0x02 0X29 0x00>;
		lcd-kit,panel-off-cmds = <0x05 0x01 0x00 0x00 0x14 0x01 0x02 0x28 0x00>;
		lcd-kit,tp-color-cmds = <0x06 0x01 0x00 0x00 0x0a 0x00 0x01 0xda>;
		lcd-kit,inversion-dot-cmds = <0x15 0x01 0x00 0x00 0x00 0x00 0x02 0xFF 0x24
		0x15 0x01 0x00 0x00 0x00 0x00 0x02 0xFB 0x01
		0x15 0x01 0x00 0x00 0x00 0x00 0x02 0xCF 0x33
		0x15 0x01 0x00 0x00 0x0a 0x00 0x02 0xFF 0x10>;
		lcd-kit,inversion-column-cmds = <0x15 0x01 0x00 0x00 0x00 0x00 0x02 0xFF 0x24
		0x15 0x01 0x00 0x00 0x00 0x00 0x02 0xFB 0x01
		0x15 0x01 0x00 0x00 0x00 0x00 0x02 0xCF 0xFF
		0x15 0x01 0x00 0x00 0x0a 0x00 0x02 0xFF 0x10>;
		lcd-kit,esd-reg-cmds = <0x06 0x01 0x00 0x00 0x0a 0x00 0x01 0x0a>;
		lcd-kit,esd-value = <0x9c>;
		lcd-kit,check-reg-cmds = <0x06 0x01 0x00 0x00 0x0a 0x00 0x01 0x0a>;
		lcd-kit,check-reg-cmds-state = "dsi_lp_mode";
		lcd-kit,check-reg-value = <0x9c>;
		lcd-kit,barcode-2d-cmds-state = "dsi_lp_mode";
		lcd-kit,barcode-2d-cmds = <0x15 0x01 0x00 0x00 0x14 0x01 0x02 0xFF 0x21
		0x06 0x01 0x00 0x00 0x0a 0x00 0x05 0xF1 0x00 0x00 0x00 0x00
		0x15 0x01 0x00 0x00 0x14 0x01 0x02 0xFA 0x05
		0x06 0x01 0x00 0x00 0x0a 0x00 0x05 0xF1 0x00 0x00 0x00 0x00
		0x15 0x01 0x00 0x00 0x14 0x01 0x02 0xFA 0x0A
		0x06 0x01 0x00 0x00 0x0a 0x00 0x05 0xF1 0x00 0x00 0x00 0x00
		0x15 0x01 0x00 0x00 0x14 0x01 0x02 0xFA 0x0F
		0x06 0x01 0x00 0x00 0x0a 0x00 0x01 0xF1
		0x15 0x01 0x00 0x00 0x14 0x01 0x02 0xFA 0x00
		0x06 0x01 0x00 0x00 0x0a 0x00 0x05 0xF2 0x00 0x00 0x00 0x00
		0x15 0x01 0x00 0x00 0x0a 0x00 0x02 0xFF 0x10>;
		lcd-kit,project-id-cmds = <0x15 0x01 0x00 0x00 0x0a 0x00 0x02 0xFF 0x10
		0x06 0x01 0x00 0x00 0x0a 0x00 0x05 0xB1 0x00 0x00 0x00 0x00
		0x15 0x01 0x00 0x00 0x0a 0x00 0x02 0xFA 0x05
		0x06 0x01 0x00 0x00 0x0a 0x00 0x05 0xB1 0x00 0x00 0x00 0x00
		0x15 0x01 0x00 0x00 0x0a 0x00 0x02 0xFF 0x10>;
		lcd-kit,project-id-cmds-state = "dsi_lp_mode";
		lcd-kit,panel-bl-maxnit-command = <0x06 0x01 0x00 0x00 0x0a 0x00 0x01 0xdb>;
		lcd-kit,panel-bl-maxnit-command-state = "dsi_lp_mode";
		lcd-kit,lcd-btb-support = <0>;
		lcd-kit,lcd-btb-check-type = <0>;
		lcd-kit,lcd-btb-gpio = <73 76>;
		lcd-kit,panel-lcm-type = <2>;
		lcd-kit,panel-ldi-dsi-mode = <1>;
		lcd-kit,panel-dsi-switch-mode = <0>;
		lcd-kit,panel-dsi-switch-mode-en = <0>;
		lcd-kit,panel-ldi-trans-seq = <0>;
		lcd-kit,panel-ldi-data-padding = <0>;
		lcd-kit,panel-ldi-packet-size = <256>;
		lcd-kit,panel-ldi-ps = <2>;
		lcd-kit,panel-vfp-lp = <0>;
		lcd-kit,panel-fbk-div = <1>;
		lcd-kit,panel-orientation = <1>;
		lcd-kit,panel-bpp = <2>;
		lcd-kit,panel-bgr-fmt = <0>;
		lcd-kit,panel-cmd-type = <8>;
		lcd-kit,panel-pxl-clk = <480>;
		lcd-kit,panel-pxl-clk-div = <0>;
		lcd-kit,panel-data-rate = <1124>;
		lcd-kit,mipi-lane-nums = <4>;
		lcd-kit,h-back-porch = <42>;
		lcd-kit,h-front-porch = <132>;
		lcd-kit,h-pulse-width = <14>;
		lcd-kit,project-id-support = <1>;
		lcd-kit,default-project-id = "B2429M1100";
		lcd-kit,v-back-porch = <10>;
		lcd-kit,v-front-porch = <2500>;
		lcd-kit,v-pulse-width = <8>;
		lcd-kit,mipi-clk-post-adjust = <0>;
		lcd-kit,mipi-lp11-flag = <0>;
		lcd-kit,esd-support = <1>;
		lcd-kit,skip-poweron-esd-check = <0>;
		lcd-kit,esd-recovery-bl-support = <1>;
		lcd-kit,thp-proximity-support = <0>;
		lcd-kit,tp-color-support = <1>;
		lcd-kit,lcd-vsp = <2 108 5500000>;
		lcd-kit,lcd-vsn = <2 109 5500000>;
		lcd-kit,lcd-power-down-vsp = <2 108 4700000>;
		lcd-kit,lcd-power-down-vsn = <2 109 4700000>;
		lcd-kit,lcd-reset = <2 40 0>;
		lcd-kit,tp-reset = <2 15 0>;
		lcd-kit,power-on-stage = <11 1 0
				3 1 1
				4 1 10
				5 2 1
				5 1 6
				5 2 1
				5 1 15
				7 1 2
				6 1 0
				8 1 0>;
		lcd-kit,lp-on-stage = <0 0 0>;
		lcd-kit,hs-on-stage = <0 0 0>;
		lcd-kit,hs-off-stage = <0 0 0>;
		lcd-kit,lp-off-stage = <0 0 0>;
		lcd-kit,power-off-stage = <7 0 0
				8 0 0
				6 0 80
				11 0 5
				4 0 0
				3 0 6>;
		lcd-kit,only-power-off-stage = <4 0 0
				3 0 6>;
		lcd-kit,pt-support = <1>;
		lcd-kit,panel-density = <320>;
		lcd-kit,ssc-disable = <1>;
		lcd-kit,inversion-support = <1>;
		lcd-kit,check-reg-support = <1>;
		lcd-kit,panel-bl-min = <80>;
		lcd-kit,panel-bl-max = <6800>;
		lcd-kit,panel-bl-max-nit = <450>;
		lcd-kit,panel-bl-boot = <255>;
		lcd-kit,mipi-non-continue-enable = <1>;
		lcd-kit,panel-getblmaxnit-type = <1>;
		lcd-kit,panel-bl-ic-ctrl-type = <6>;
		lcd-kit,panel-bias-ic-ctrl-type = <3>;
		lcd-kit,oem-info-support = <1>;
		lcd-kit,oem-barcode-2d-support = <1>;
		lcd-kit,oem-barcode-2d-num-offset = <0>;
		lcd-kit,panel-on-always-reset = <1>;
		lcd-kit,panel-gpio-offset = <286>;
		lcd-kit,backlight-order = <0>;
		lcd-kit,fps-support = <1>;
		lcd-kit,fps-high-60-mipi-hopping = <101 100 14 2496 24 10 868 2496>;
		lcd-kit,fps-90-mipi-hopping = <101 100 14 36 24 10 868 36>;
		lcd-kit,fps-high-60-dsi-timming = <132 42 14 2500 10 8 60 1124 0>;
		lcd-kit,fps-90-dsi-timming = <132 42 14 876 10 8 90 1124 0>;
		lcd-kit,fps-120-dsi-timming = <132 42 14 56 10 8 120 1124 0>;
		lcd-kit,panel-support-fps-list = <1 2 3>;
		lcd-kit,dsc-enable = <1>;
		lcd-kit,dsc-ver = <17>;
		lcd-kit,dsc-slice-mode = <1>;
		lcd-kit,dsc-rgb-swap = <0>;
		lcd-kit,dsc-cfg = <34>;
		lcd-kit,dsc-rct-on = <1>;
		lcd-kit,dsc-bit-per-channel = <8>;
		lcd-kit,dsc-line-buf-depth = <9>;
		lcd-kit,dsc-bp-enable = <1>;
		lcd-kit,dsc-bit-per-pixel = <128>;
		lcd-kit,dsc-pic-height = <2388>;
		lcd-kit,dsc-pic-width = <1080>;
		lcd-kit,dsc-slice-height = <12>;
		lcd-kit,dsc-slice-width = <540>;
		lcd-kit,dsc-chunk-size = <540>;
		lcd-kit,dsc-xmit-delay = <512>;
		lcd-kit,dsc-dec-delay = <526>;
		lcd-kit,dsc-scale-value = <32>;
		lcd-kit,dsc-increment-interval = <287>;
		lcd-kit,dsc-decrement-interval = <7>;
		lcd-kit,dsc-line-bpg-offset = <12>;
		lcd-kit,dsc-nfl-bpg-offset = <2235>;
		lcd-kit,dsc-slice-bpg-offset = <2170>;
		lcd-kit,dsc-initial-offset = <6144>;
		lcd-kit,dsc-final-offset = <4336>;
		lcd-kit,dsc-flatness-minqp = <3>;
		lcd-kit,dsc-flatness-maxqp = <12>;
		lcd-kit,dsc-rc-model-size = <8192>;
		lcd-kit,dsc-rc-edge-factor = <6>;
		lcd-kit,dsc-rc-quant-incr-limit0 = <11>;
		lcd-kit,dsc-rc-quant-incr-limit1 = <11>;
		lcd-kit,dsc-rc-tgt-offset-hi = <3>;
		lcd-kit,dsc-rc-tgt-offset-lo = <3>;
		lcd-kit,vetical-refresh = <60>;
		lcd-kit,inversion-column-cmds-state = "dsi_lp_mode";
		lcd-kit,inversion-dot-cmds-state = "dsi_lp_mode";
		lcd-kit,proximity-reset-delay-min = <65>;
		lcd-kit,quickly-sleep-out-support = <1>;
		lcd-kit,quickly-sleep-out-interval = <100>;
		lcd-kit,mipi-hop-h-back-porch = <10>;
		lcd-kit,mipi-hop-h-front-porch = <32>;
		lcd-kit,mipi-hop-h-pulse-width = <10>;
		lcd-kit,mipi-hop-v-back-porch = <60>;
		lcd-kit,mipi-hop-v-front-porch = <14>;
		lcd-kit,mipi-hop-v-pulse-width = <30>;
		lcd-kit,mipi-hop-lp-v-front-porch = <14>;
		lcd-kit,Does-lcd-poweron-tp = <1>;
		lcd-kit,mipi-hop-support = <0>;
		lcd-kit,mipi-read-gerneric = <1>;
		lcd-kit,rgbw-support = <0>;
		lcd-kit,imax-lcd-luminance = <500>;
		lcd-kit,imin-lcd-luminance = <3>;
		lcd-kit,panel-blmaxnit-min-value = <400>;
		lcd-kit,mtk-high-left-time-th-us = <5000>;
		lcd-kit,mtk-high-right-time-th-us = <9000>;
		lcd-kit,mtk-high-te-inerval-time-us = <11111>;
		lcd-kit,mtk-low-left-time-th-us = <9000>;
		lcd-kit,mtk-low-right-time-th-us = <15000>;
		lcd-kit,mtk-low-te-inerval-time-us = <16667>;
		lcd-kit,sn-code-support = <1>;
		lcd-kit,panel-round-corner-enable = <0>;
		lcd-kit,panel-round-corner-full-content = <0>;
		lcd-kit,panel-round-corner-h = <0>;
		lcd-kit,panel-round-corner-h-bot = <0>;
    };
};