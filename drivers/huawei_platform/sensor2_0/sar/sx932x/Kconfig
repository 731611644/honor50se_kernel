## drivers/huawei_platform/sensor2_0/sar/sx932x/Kconfig
```kconfig
config KERNEL_SAR_SX932X
	bool "abov sx932x for MediaTek package"
	default n
	help
	  It support different type sensor
	  in this platform. If this option
	  is set, it will support sar sensor sx932x.
```

## drivers/mmc/Kconfig
```kconfig
#
# MMC subsystem configuration
#

menuconfig MMC
	tristate "MMC/SD/SDIO card support"
	depends on HAS_IOMEM
	help
	  This selects MultiMediaCard, Secure Digital and Secure
	  Digital I/O support.

	  If you want MMC/SD/SDIO support, you should say Y here and
	  also to your specific host controller driver.

if MMC

config HONOR_VENDOR_MMC
	bool "mmc driver fetures support of HONOR"
	depends on MMC != n
	default y
	help
	  This selects the mmc driver fetures support of HONOR

source "drivers/mmc/core/Kconfig"

source "drivers/mmc/host/Kconfig"

endif # MMC
```
